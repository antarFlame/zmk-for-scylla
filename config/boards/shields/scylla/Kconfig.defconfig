## config/boards/shields/scylla/Kconfig.defconfig
```kconfig
if SHIELD_SCYLLA_LEFT

    config ZMK_KEYBOARD_NAME
        default "Scylla_antar"

    config ZMK_SPLIT_BLE_ROLE_CENTRAL
        default y

endif

if SHIELD_SCYLLA_LEFT || SHIELD_SCYLLA_RIGHT

    config ZMK_SPLIT
        default y

endif
```
